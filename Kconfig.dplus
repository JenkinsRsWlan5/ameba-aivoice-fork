## Kconfig.dplus
```kconfig
config AIVOICE_EN_MENU
    bool "Enable AIVoice"
    select AIVOICE_EN if WHC_HOST || WHC_NONE

if AIVOICE_EN_MENU
    choice
        prompt "Select AFE Resource"
        default AFE_RES_1MIC_MENU

        config AFE_RES_1MIC_MENU
            bool "afe_res_1mic"
            select AFE_RES_1MIC if WHC_HOST || WHC_NONE

    endchoice

    choice
        prompt "Select KWS Resource"
        default KWS_XIAOQIANGXIAOQIANG_NIHAOXIAOQIANG_V5_125K_MENU

        config KWS_XIAOQIANGXIAOQIANG_NIHAOXIAOQIANG_V5_125K_MENU
            bool "kws_res_xqxq"
            select KWS_XIAOQIANGXIAOQIANG_NIHAOXIAOQIANG_V5_125K if WHC_HOST || WHC_NONE

    endchoice
endif

config AIVOICE_EN
    bool

config AFE_RES_1MIC
    bool

config KWS_XIAOQIANGXIAOQIANG_NIHAOXIAOQIANG_V5_125K
    bool
```
